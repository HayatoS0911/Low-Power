# file: LowPowerTest.ioc
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Mcu.Family=STM32L4
Mcu.Name=STM32L476R(C-E-G)Tx
Mcu.Package=LQFP64
NVIC.PriorityGroup=NVIC_PRIORITYGROUP_4
NVIC.RTC_WKUP_IRQn=true\:0\:0\:false\:false\:true\:true\:true\:true
NVIC.TIM2_IRQn=true\:0\:0\:false\:false\:true\:true\:true\:true
PA13\ (JTMS-SWDIO).GPIO_Label=TMS
PA13\ (JTMS-SWDIO).Mode=Serial_Wire
PA13\ (JTMS-SWDIO).Signal=SYS_JTMS-SWDIO
PA14\ (JTCK-SWCLK).GPIO_Label=TCK
PA14\ (JTCK-SWCLK).Mode=Serial_Wire
PA14\ (JTCK-SWCLK).Signal=SYS_JTCK-SWCLK
PA5.GPIO_Label=LD2 [green Led]
PA5.GPIO_ModeDefaultOutputPP=GPIO_MODE_OUTPUT_PP
PA5.GPIO_PuPd=GPIO_NOPULL
PA5.GPIO_Speed=GPIO_SPEED_FREQ_LOW
PA5.Signal=GPIO_Output
PB3\ (JTDO-TRACESWO).GPIO_Label=SWO
PB3\ (JTDO-TRACESWO).Signal=SYS_JTDO-SWO
PC14-OSC32_IN\ (PC14).Mode=LSE-External-Oscillator
PC14-OSC32_IN\ (PC14).Signal=RCC_OSC32_IN
PC15-OSC32_OUT\ (PC15).Mode=LSE-External-Oscillator
PC15-OSC32_OUT\ (PC15).Signal=RCC_OSC32_OUT
PH0-OSC_IN\ (PH0).Signal=RCC_OSC_IN
PH1-OSC_OUT\ (PH1).Signal=RCC_OSC_OUT
ProjectManager.HeapSize=0x200
ProjectManager.StackSize=0x400
ProjectManager.TargetToolchain=STM32CubeIDE
RCC.ADCFreq_Value=64000000
RCC.AHBFreq_Value=80000000
RCC.APB1Freq_Value=80000000
RCC.APB1TimFreq_Value=80000000
RCC.APB2Freq_Value=80000000
RCC.APB2TimFreq_Value=80000000
RCC.CortexFreq_Value=80000000
RCC.HCLKFreq_Value=80000000
RCC.HSE_VALUE=8000000
RCC.HSI_VALUE=16000000
RCC.LPTIM1CLockSelection=RCC_LPTIM1CLKSOURCE_LSI
RCC.MSIClockRange=RCC_MSIRANGE_5
RCC.MSI_VALUE=2000000
RCC.PLLN=10
RCC.PLLSourceVirtual=RCC_PLLSOURCE_HSI
RCC.PREFETCH_ENABLE=1
RCC.RTCClockSelection=RCC_RTCCLKSOURCE_LSE
RCC.SYSCLKFreq_VALUE=80000000
RCC.SYSCLKSource=RCC_SYSCLKSOURCE_PLLCLK
RCC.USBFreq_Value=64000000
RCC.VCOOutputFreq_Value=160000000
RTC.WakeUpClock-WakeUp=RTC_WAKEUPCLOCK_CK_SPRE_16BITS
TIM2.Period=10000-1
TIM2.Prescaler=8000-1
VP_RTC_VS_RTC_Activate.Mode=RTC_Enabled
VP_RTC_VS_RTC_WakeUp_intern.Mode=WakeUp
VP_TIM2_VS_ClockSourceINT.Mode=Internal
board=NUCLEO-L476RG

// file: Core/Src/main.c
/* USER CODE BEGIN Header */
/**
  ******************************************************************************
  * @file           : main.c
  * @brief          : Main program body
  ******************************************************************************
  * @attention
  *
  * Copyright (c) 2022 STMicroelectronics.
  * All rights reserved.
  *
  * This software is licensed under terms that can be found in the LICENSE file
  * in the root directory of this software component.
  * If no LICENSE file comes with this software, it is provided AS-IS.
  *
  ******************************************************************************
  */
/* USER CODE END Header */
#include "main.h"
#include "rtc.h"
#include "tim.h"
#include "gpio.h"

/* USER CODE BEGIN Includes */
#include <stdio.h>
/* USER CODE END Includes */

/* USER CODE BEGIN PV */
uint32_t timerCounter = 0;
/* USER CODE END PV */

void SystemClock_Config(void);
/* USER CODE BEGIN PFP */
void SystemClock_Config_UseMSI(void);
/* USER CODE END PFP */

int main(void)
{
  /* USER CODE BEGIN 1 */
  uint8_t mode = 0;
  /* USER CODE END 1 */
  /* MCU Configuration--------------------------------------------------------*/
  /* Reset of all peripherals, Initializes the Flash interface and the Systick. */
  HAL_Init();
  /* Configure the system clock */
  SystemClock_Config();
  /* Initialize all configured peripherals */
  MX_GPIO_Init();
  MX_RTC_Init();
  MX_TIM2_Init();
  /* Infinite loop */
  /* USER CODE BEGIN WHILE */

  // select HSI as system clock source after Wake-Up from Stop mode
  __HAL_RCC_WAKEUPSTOP_CLK_CONFIG( RCC_STOP_WAKEUPCLOCK_HSI );

  while (1)
  {
    /* USER CODE END WHILE */

	  switch(mode)
	  {
	  	  case 0: // Run
	  		  while (1)
	  		  {

	  		  }
	  		  break;
	  	  case 1: // LPRun
	  		  HAL_SuspendTick();							// Stop Systick timer

	  		  SystemClock_Config_UseMSI();						// Use System Clock MSI
	  		  HAL_PWREx_EnableLowPowerRunMode();					// Enter Low Power Run
	  		  HAL_Delay(3000);							// Wait 3000ms
	  		  HAL_PWREx_DisableLowPowerRunMode();					// Disable Low Power Run
	  		  SystemClock_Config();							// Use Sysmtem Clock HSI

	  		  HAL_GPIO_WritePin(LD2_GPIO_Port, LD2_Pin, GPIO_PIN_SET);		// LD2 ON
	  		  HAL_ResumeTick();							// Resume Systick timer
	  		  HAL_Delay(1000);							// Wait 1000ms
	  		  HAL_GPIO_WritePin(LD2_GPIO_Port, LD2_Pin, GPIO_PIN_RESET);		// LD2 OFF
	  		  break;
	  	  case 2: // HAL_Delay
	  		  while(1)
	  		  {
	  			  HAL_Delay(10000);						// Wait 10000ms
	  		  }
	  		  break;
	  	  case 3: // Sleep
	  		  HAL_RTCEx_DeactivateWakeUpTimer(&hrtc);				// Disable Wakeup Timer
	  		  HAL_RTCEx_SetWakeUpTimer_IT(&hrtc,10,RTC_WAKEUPCLOCK_CK_SPRE_16BITS);	// Set wake up timer with intterupt RTC
	  		  HAL_SuspendTick();							// Stop Systick timer

	  		  HAL_PWR_EnterSLEEPMode(PWR_MAINREGULATOR_ON,PWR_SLEEPENTRY_WFE);	// Enter Sleep Mode, WakeUpEvent WFE

	  		  HAL_GPIO_WritePin(LD2_GPIO_Port, LD2_Pin, GPIO_PIN_SET);		// LD2 ON
	  		  HAL_ResumeTick();							// Resume Systick timer
	  		  HAL_Delay(1000);							// Wait 1000ms
	  		  HAL_GPIO_WritePin(LD2_GPIO_Port, LD2_Pin, GPIO_PIN_RESET);		// LD2 OFF
	  		  break;
	  	  case 4: // LPSleep
	  		  SystemClock_Config_UseMSI();						// Use System Clock MSI
	  		  HAL_RTCEx_DeactivateWakeUpTimer(&hrtc);				// Disable Wakeup Timer
	  		  HAL_RTCEx_SetWakeUpTimer_IT(&hrtc,10,RTC_WAKEUPCLOCK_CK_SPRE_16BITS);	// Set wake up timer with intterupt RTC
	  		  HAL_SuspendTick();							// Stop Systick timer

	  		  HAL_PWR_EnterSLEEPMode(PWR_LOWPOWERREGULATOR_ON,PWR_SLEEPENTRY_WFE);	// Enter Low Power Sleep Mode, WakeUpEvent WFE
	  		  HAL_PWREx_DisableLowPowerRunMode();					// Disable Low Power Run
	  		  SystemClock_Config();							// Use Sysmtem Clock HSI

	  		  HAL_GPIO_WritePin(LD2_GPIO_Port, LD2_Pin, GPIO_PIN_SET);		// LD2 ON
	  		  HAL_ResumeTick();							// Resume Systick timer
	  		  HAL_Delay(1000);							// Wait 1000ms
	  		  HAL_GPIO_WritePin(LD2_GPIO_Port, LD2_Pin, GPIO_PIN_RESET);		// LD2 OFF
	  		  break;
	  	  case 5: // Stop0
	  		  HAL_RTCEx_DeactivateWakeUpTimer(&hrtc);				// Disable Wakeup Timer
	  		  HAL_RTCEx_SetWakeUpTimer_IT(&hrtc,10,RTC_WAKEUPCLOCK_CK_SPRE_16BITS);	// Set wake up timer with intterupt RTC
	  		  HAL_SuspendTick();							// Stop Systick timer

	  		  HAL_PWR_EnterSTOPMode(PWR_MAINREGULATOR_ON, PWR_STOPENTRY_WFE);	// Enter Stop0 Mode, Wake Up Event
	  		  HAL_PWREx_DisableLowPowerRunMode();					// Disable Low Power Run
	  		  SystemClock_Config();							// Use Sysmtem Clock HSI

	  		  HAL_GPIO_WritePin(LD2_GPIO_Port, LD2_Pin, GPIO_PIN_SET);		// LD2 ON
	  		  HAL_ResumeTick();							// Resume Systick timer
	  		  HAL_Delay(1000);							// Wait 1000ms
			  HAL_GPIO_WritePin(LD2_GPIO_Port, LD2_Pin, GPIO_PIN_RESET);		// LD2 OFF
			  break;
	  	  case 6: // stop1
	  		  HAL_RTCEx_DeactivateWakeUpTimer(&hrtc);				// Disable Wakeup Timer
	  		  HAL_RTCEx_SetWakeUpTimer_IT(&hrtc,10,RTC_WAKEUPCLOCK_CK_SPRE_16BITS);	// Set wake up timer with intterupt RTC
	  		  HAL_SuspendTick();							// Stop Systick timer

	  		  HAL_PWR_EnterSTOPMode(PWR_LOWPOWERREGULATOR_ON, PWR_STOPENTRY_WFE);	// Enter Stop1 Mode, Wake Up Event
	  		  HAL_PWREx_DisableLowPowerRunMode();					// Disable Low Power Run
	  		  SystemClock_Config();							// Use Sysmtem Clock HSI

	  		  HAL_GPIO_WritePin(LD2_GPIO_Port, LD2_Pin, GPIO_PIN_SET);		// LD2 ON
	  		  HAL_ResumeTick();							// Resume Systick timer
	  		  HAL_Delay(1000);							// Wait 1000ms
	  		  HAL_GPIO_WritePin(LD2_GPIO_Port, LD2_Pin, GPIO_PIN_RESET);		// LD2 OFF
	  		  break;
	  	  case 7: // stop2
	  		  HAL_RTCEx_DeactivateWakeUpTimer(&hrtc);				// Disable Wakeup Timer
	  		  HAL_RTCEx_SetWakeUpTimer_IT(&hrtc,10,RTC_WAKEUPCLOCK_CK_SPRE_16BITS);	// Set wake up timer with intterupt RTC
	  		  HAL_SuspendTick();							// Stop Systick timer

	  		  HAL_PWREx_EnterSTOP2Mode(PWR_STOPENTRY_WFE);				// Enter Stop2 Mode, Wake Up Event
	  		  HAL_PWREx_DisableLowPowerRunMode();					// Disable Low Power Run
	  		  SystemClock_Config();							// Use Sysmtem Clock HSI

	  		  HAL_GPIO_WritePin(LD2_GPIO_Port, LD2_Pin, GPIO_PIN_SET);		// LD2 ON
	  		  HAL_ResumeTick();							// Resume Systick timer
	  		  HAL_Delay(1000);							// Wait 1000ms
	  		  HAL_GPIO_WritePin(LD2_GPIO_Port, LD2_Pin, GPIO_PIN_RESET);		// LD2 OFF
	  		  break;
	  	  case 8:	// Stanby Mode
	  		  // Check if the SB flag is set
	  		  if (__HAL_PWR_GET_FLAG(PWR_FLAG_SB) != RESET)
	  		  {
	  			  __HAL_PWR_CLEAR_FLAG(PWR_FLAG_SB);				// Clear Stanby Flag

	  			  for(int i = 0; i < 5;i++)
	  			  {
	  				  HAL_GPIO_TogglePin(LD2_GPIO_Port, LD2_Pin);		// Toggle LD2
	  				  HAL_Delay(100);					// Wait 100ms
	  			  }
	  			  HAL_GPIO_WritePin(LD2_GPIO_Port, LD2_Pin, GPIO_PIN_RESET);	// LD2 OFF
	  		  }

	  		  while (1)
	  		  {
	  			  HAL_SuspendTick();						// Stop Systick timer
	  			  HAL_RTCEx_DeactivateWakeUpTimer(&hrtc);			// RTC timer wake up timer stop
	  			  HAL_RTCEx_SetWakeUpTimer_IT(&hrtc,10,RTC_WAKEUPCLOCK_CK_SPRE_16BITS);	// Set wake up timer with intterupt RTC
	  			  HAL_PWR_EnterSTANDBYMode();					// Enter Stanby Mode
	  		  }
	  	  case 9: // Shutdown
	  		  while (1)
	  		  {
	  			  HAL_SuspendTick();						// Stop Systick timer
	  			  HAL_RTCEx_DeactivateWakeUpTimer(&hrtc);			// RTC timer wake up timer stop
	  			  HAL_RTCEx_SetWakeUpTimer_IT(&hrtc,10,RTC_WAKEUPCLOCK_CK_SPRE_16BITS);	// Set wake up timer with intterupt RTC
	  			  HAL_PWREx_EnterSHUTDOWNMode();				// Enter Shutdown Mode
	  		  }
	  		  break;
}
  }
}

void SystemClock_Config(void)
{
  RCC_OscInitTypeDef RCC_OscInitStruct = {0};
  RCC_ClkInitTypeDef RCC_ClkInitStruct = {0};

  /** Configure the main internal regulator output voltage
  */
  if (HAL_PWREx_ControlVoltageScaling(PWR_REGULATOR_VOLTAGE_SCALE1) != HAL_OK)
  {
    Error_Handler();
  }

  /** Configure LSE Drive Capability
  */
  HAL_PWR_EnableBkUpAccess();
  __HAL_RCC_LSEDRIVE_CONFIG(RCC_LSEDRIVE_LOW);

  /** Initializes the RCC Oscillators according to the specified parameters
  * in the RCC_OscInitTypeDef structure.
  */
  RCC_OscInitStruct.OscillatorType = RCC_OSCILLATORTYPE_HSI|RCC_OSCILLATORTYPE_LSE;
  RCC_OscInitStruct.LSEState = RCC_LSE_ON;
  RCC_OscInitStruct.HSIState = RCC_HSI_ON;
  RCC_OscInitStruct.HSICalibrationValue = RCC_HSICALIBRATION_DEFAULT;
  RCC_OscInitStruct.PLL.PLLState = RCC_PLL_ON;
  RCC_OscInitStruct.PLL.PLLSource = RCC_PLLSOURCE_HSI;
  RCC_OscInitStruct.PLL.PLLM = 1;
  RCC_OscInitStruct.PLL.PLLN = 10;
  RCC_OscInitStruct.PLL.PLLP = RCC_PLLP_DIV7;
  RCC_OscInitStruct.PLL.PLLQ = RCC_PLLQ_DIV2;
  RCC_OscInitStruct.PLL.PLLR = RCC_PLLR_DIV2;
  if (HAL_RCC_OscConfig(&RCC_OscInitStruct) != HAL_OK)
  {
    Error_Handler();
  }

  /** Initializes the CPU, AHB and APB buses clocks
  */
  RCC_ClkInitStruct.ClockType = RCC_CLOCKTYPE_HCLK|RCC_CLOCKTYPE_SYSCLK
                              |RCC_CLOCKTYPE_PCLK1|RCC_CLOCKTYPE_PCLK2;
  RCC_ClkInitStruct.SYSCLKSource = RCC_SYSCLKSOURCE_PLLCLK;
  RCC_ClkInitStruct.AHBCLKDivider = RCC_SYSCLK_DIV1;
  RCC_ClkInitStruct.APB1CLKDivider = RCC_HCLK_DIV1;
  RCC_ClkInitStruct.APB2CLKDivider = RCC_HCLK_DIV1;

  if (HAL_RCC_ClockConfig(&RCC_ClkInitStruct, FLASH_LATENCY_4) != HAL_OK)
  {
    Error_Handler();
  }
}

/* USER CODE BEGIN 4 */

/**
  * @brief System Clock Configuration Use MSI
  * @retval None
  */
void SystemClock_Config_UseMSI(void)
{
  RCC_OscInitTypeDef RCC_OscInitStruct = {0};
  RCC_ClkInitTypeDef RCC_ClkInitStruct = {0};

  /** Configure the main internal regulator output voltage
  */
  if (HAL_PWREx_ControlVoltageScaling(PWR_REGULATOR_VOLTAGE_SCALE1) != HAL_OK)
  {
    Error_Handler();
  }

  /** Configure LSE Drive Capability
  */
  HAL_PWR_EnableBkUpAccess();
  __HAL_RCC_LSEDRIVE_CONFIG(RCC_LSEDRIVE_LOW);

  /** Initializes the RCC Oscillators according to the specified parameters
  * in the RCC_OscInitTypeDef structure.
  */
  RCC_OscInitStruct.OscillatorType = RCC_OSCILLATORTYPE_LSI|RCC_OSCILLATORTYPE_LSE
                              |RCC_OSCILLATORTYPE_MSI;
  RCC_OscInitStruct.LSEState = RCC_LSE_ON;
  RCC_OscInitStruct.LSIState = RCC_LSI_ON;
  RCC_OscInitStruct.MSIState = RCC_MSI_ON;
  RCC_OscInitStruct.MSICalibrationValue = 0;
  RCC_OscInitStruct.MSIClockRange = RCC_MSIRANGE_5;
  RCC_OscInitStruct.PLL.PLLState = RCC_PLL_NONE;
  if (HAL_RCC_OscConfig(&RCC_OscInitStruct) != HAL_OK)
  {
    Error_Handler();
  }

  /** Initializes the CPU, AHB and APB buses clocks
  */
  RCC_ClkInitStruct.ClockType = RCC_CLOCKTYPE_HCLK|RCC_CLOCKTYPE_SYSCLK
                              |RCC_CLOCKTYPE_PCLK1|RCC_CLOCKTYPE_PCLK2;
  RCC_ClkInitStruct.SYSCLKSource = RCC_SYSCLKSOURCE_MSI;
  RCC_ClkInitStruct.AHBCLKDivider = RCC_SYSCLK_DIV1;
  RCC_ClkInitStruct.APB1CLKDivider = RCC_HCLK_DIV1;
  RCC_ClkInitStruct.APB2CLKDivider = RCC_HCLK_DIV1;

  if (HAL_RCC_ClockConfig(&RCC_ClkInitStruct, FLASH_LATENCY_0) != HAL_OK)
  {
    Error_Handler();
  }

  /** Enable MSI Auto calibration
  */
  HAL_RCCEx_EnableMSIPLLMode();
}

/**
  * @brief TIM Period Elapsed Callback
  * @param  htim: call back tim
  * @retval None
  */
void HAL_TIM_PeriodElapsedCallback(TIM_HandleTypeDef *htim)
{
    if (htim == &htim2)																// timer "htim2" ?
    {
    	if(timerCounter > 0)														// Check the number of timer counters remaining
    	{
    		timerCounter--;															// timer counter -1
    		HAL_TIM_Base_Start_IT(&htim2);											// Start TIM2
    	}
    }
}

/* USER CODE END 4 */

void Error_Handler(void)
{
  __disable_irq();
  while (1)
  {
  }
}
